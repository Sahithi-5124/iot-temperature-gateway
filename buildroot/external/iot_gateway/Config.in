## buildroot/external/iot_gateway/Config.in
```kconfig
menu "IoT Gateway"

source "$BR2_EXTERNAL_IOT_GATEWAY_PATH/package/iot-gateway/Config.in"

endmenu
```

## buildroot/external/iot_gateway/configs/iot_gateway_x86_64_defconfig
```kconfig
BR2_x86_64=y
BR2_PACKAGE_HOST_LINUX_HEADERS_CUSTOM_6_18=y
BR2_DOWNLOAD_FORCE_CHECK_HASHES=y
BR2_GLOBAL_PATCH_DIR="$(BR2_EXTERNAL_IOT_GATEWAY_PATH)/patches"
BR2_SYSTEM_DHCP="eth0"
BR2_ROOTFS_POST_IMAGE_SCRIPT="$(BR2_EXTERNAL_IOT_GATEWAY_PATH)/board/x86_64/post-image.sh"
BR2_LINUX_KERNEL=y
BR2_LINUX_KERNEL_CUSTOM_VERSION=y
BR2_LINUX_KERNEL_CUSTOM_VERSION_VALUE="6.18.7"
BR2_LINUX_KERNEL_USE_CUSTOM_CONFIG=y
BR2_LINUX_KERNEL_CUSTOM_CONFIG_FILE="$(BR2_EXTERNAL_IOT_GATEWAY_PATH)/board/x86_64/linux.config"
BR2_LINUX_KERNEL_NEEDS_HOST_LIBELF=y
BR2_TARGET_ROOTFS_EXT2=y
# BR2_TARGET_ROOTFS_TAR is not set

# IoT temperature gateway application
BR2_PACKAGE_IOT_GATEWAY=y

# Mosquitto client library only
BR2_PACKAGE_MOSQUITTO_WS_NONE=y
# BR2_PACKAGE_MOSQUITTO_CLIENTS is not set
# BR2_PACKAGE_MOSQUITTO_APPS is not set
# BR2_PACKAGE_MOSQUITTO_BROKER is not set
```

## buildroot/external/iot_gateway/package/iot-gateway/Config.in
```kconfig
config BR2_PACKAGE_IOT_GATEWAY
	bool "IoT temperature gateway"
	depends on BR2_USE_MMU
	depends on !BR2_STATIC_LIBS
	select BR2_PACKAGE_MOSQUITTO
	help
	  Lightweight IoT temperature monitoring application.
	  Publishes temperature readings and alerts using MQTT.
```
